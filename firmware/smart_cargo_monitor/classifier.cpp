// classifier.cpp — Phase 5: Non-blocking inference implementation
//
// Uses the Random Forest C header (model_rf.h) generated by train_model.py.
// Falls back to a safe stub if model_rf.h is missing (compile guard).
//
// The model_rf.h file is expected at:
//   firmware/smart_cargo_monitor/model_rf.h
// Copy it there after running:
//   python tinyml/train_model.py --dataset dataset/ --output models/
//   cp models/model_rf.h firmware/smart_cargo_monitor/model_rf.h
//
#include "classifier.h"
#include "feature_extractor.h"
#include "mpu6050_sensor.h"   // for isMPUDetected()
#include "config.h"

// ── Include the trained model (generated by train_model.py) ─────────────
#if __has_include("model_rf.h")
  #include "model_rf.h"
  #define CLASSIFIER_MODEL_LOADED 1
#else
  #define CLASSIFIER_MODEL_LOADED 0
  #pragma message("model_rf.h not found — classifier will return UNCERTAIN for all windows")
#endif

// ── Ring buffer ──────────────────────────────────────────────────────────
static int16_t s_ringbuf[FE_WINDOW_SAMPLES][6];   // 125 * 6 * 2 = 1500 bytes
static uint8_t s_write_pos  = 0;
static uint8_t s_fill_count = 0;    // 0..125 samples collected so far

static ClassifierResult s_result;

static unsigned long s_last_sample_ms = 0;

// ── MPU direct register read (minimal, reuses Wire) ─────────────────────
// This reads 14 bytes from the MPU directly, independent of readMotionSensor().
// Called at 125 Hz from loop() via classifierFeedSample().
static bool readMPURaw(int16_t raw[6]) {
    const uint8_t addr = getMPUAddress();  // Use runtime getter (supports 0x68 or 0x69)


    Wire.beginTransmission(addr);
    Wire.write(MPU_REG_ACCEL_XOUT);
    if (Wire.endTransmission(false) != 0) return false;
    if (Wire.requestFrom((int)addr, 14) != 14) return false;

    raw[0] = (int16_t)((Wire.read() << 8) | Wire.read());  // AX
    raw[1] = (int16_t)((Wire.read() << 8) | Wire.read());  // AY
    raw[2] = (int16_t)((Wire.read() << 8) | Wire.read());  // AZ
    (void)Wire.read(); (void)Wire.read();                   // TEMP (discard)
    raw[3] = (int16_t)((Wire.read() << 8) | Wire.read());  // GX
    raw[4] = (int16_t)((Wire.read() << 8) | Wire.read());  // GY
    raw[5] = (int16_t)((Wire.read() << 8) | Wire.read());  // GZ
    return true;
}

// ── Inference ────────────────────────────────────────────────────────────
static void runInference(const int16_t window[FE_WINDOW_SAMPLES][6]) {
    float features[FE_NUM_FEATURES];
    extractFeatures(window, features);

#if CLASSIFIER_MODEL_LOADED
    float votes[4] = {0.0f, 0.0f, 0.0f, 0.0f};
    int8_t label = rf_predict(features, votes);

    float top_conf = votes[(int)label];
    s_result.label       = (top_conf >= CLASSIFIER_CONFIDENCE_THRESHOLD)
                            ? (uint8_t)label
                            : CLASS_UNCERTAIN;
    s_result.confidence  = top_conf;
    s_result.votes[0]    = votes[0];
    s_result.votes[1]    = votes[1];
    s_result.votes[2]    = votes[2];
    s_result.votes[3]    = votes[3];
#else
    // No model loaded — always return uncertain
    s_result.label      = CLASS_UNCERTAIN;
    s_result.confidence = 0.0f;
    s_result.votes[0] = s_result.votes[1] =
    s_result.votes[2] = s_result.votes[3] = 0.0f;
#endif

    s_result.timestamp_ms = millis();
    s_result.valid        = true;
}

// ── Public API ───────────────────────────────────────────────────────────
void initClassifier() {
    memset(s_ringbuf, 0, sizeof(s_ringbuf));
    s_write_pos   = 0;
    s_fill_count  = 0;
    s_last_sample_ms = 0;
    memset(&s_result, 0, sizeof(s_result));
    s_result.valid = false;

#if CLASSIFIER_MODEL_LOADED
    Serial.println("[OK] Cargo classifier: model_rf.h loaded.");
    Serial.printf("[OK]   Trees: %d  Features: %d\n", RF_NUM_TREES, RF_NUM_FEATURES);
#else
    Serial.println("[WARN] Cargo classifier: no model_rf.h — always UNCERTAIN.");
#endif
}

void classifierFeedSample() {
    if (!isMPUDetected()) return;

    unsigned long now = millis();
    if (now - s_last_sample_ms < CLASSIFIER_SAMPLE_INTERVAL_MS) return;
    s_last_sample_ms = now;

    int16_t raw[6];
    if (!readMPURaw(raw)) return;

    // Write to ring buffer (circular)
    memcpy(s_ringbuf[s_write_pos], raw, sizeof(raw));
    s_write_pos = (s_write_pos + 1) % FE_WINDOW_SAMPLES;
    if (s_fill_count < FE_WINDOW_SAMPLES) s_fill_count++;

    // Once we have a full window, re-order to linear time order and run inference
    if (s_fill_count == FE_WINDOW_SAMPLES) {
        // s_ringbuf is already filled; s_write_pos points to oldest sample.
        // Re-linearize into a temporary buffer for feature extraction.
        static int16_t s_ordered[FE_WINDOW_SAMPLES][6];
        for (int i = 0; i < FE_WINDOW_SAMPLES; i++) {
            int src = (s_write_pos + i) % FE_WINDOW_SAMPLES;
            memcpy(s_ordered[i], s_ringbuf[src], 12);
        }
        runInference(s_ordered);  // Pass linearized (time-ordered) buffer
        // After inference, reset fill_count so next window starts fresh.
        // 50% overlap: advance by WINDOW_SAMPLES/2 samples (keep half).
        s_fill_count = FE_WINDOW_SAMPLES / 2;   // 62 samples retained
    }
}

const ClassifierResult& getClassifierResult() {
    return s_result;
}

const char* classifierLabelStr(uint8_t label) {
    if (label > CLASS_UNCERTAIN) label = CLASS_UNCERTAIN;
    return kClassLabels[label];
}

// ── Serial test mode ─────────────────────────────────────────────────────
// Enter by sending 'T' over Serial at 115200. Reads window CSV, prints result.
// CSV format: one line per sample, 6 comma-separated int16 values (ax,ay,az,gx,gy,gz)
// Send 125 lines to trigger one inference.
void classifierTestMode() {
    Serial.println("[TEST MODE] Cargo classifier Serial replay.");
    Serial.println("  Send 125 lines of: ax,ay,az,gx,gy,gz (int16 raw counts)");
    Serial.println("  Type 'Q' to quit.");

    int16_t testbuf[FE_WINDOW_SAMPLES][6];
    int sample_idx = 0;
    char line[64];
    int  lpos = 0;

    while (true) {
        if (!Serial.available()) continue;
        char c = Serial.read();

        if (c == 'Q' || c == 'q') {
            Serial.println("[TEST MODE] Exiting.");
            break;
        }

        if (c == '\n' || c == '\r') {
            if (lpos == 0) continue;
            line[lpos] = '\0';
            lpos = 0;

            // Parse 6 comma-separated int16 values
            int16_t vals[6];
            int vi = 0;
            char* tok = strtok(line, ",");
            while (tok && vi < 6) {
                vals[vi++] = (int16_t)atoi(tok);
                tok = strtok(nullptr, ",");
            }
            if (vi == 6) {
                memcpy(testbuf[sample_idx], vals, 12);
                sample_idx++;
                if (sample_idx == FE_WINDOW_SAMPLES) {
                    // Run inference
                    float feats[FE_NUM_FEATURES];
                    extractFeatures(testbuf, feats);

                    Serial.println("[TEST] Features:");
                    for (int f = 0; f < FE_NUM_FEATURES; f++) {
                        Serial.printf("  [%2d] %-25s = %.6f\n",
                                      f, kFeatureNames[f], feats[f]);
                    }

#if CLASSIFIER_MODEL_LOADED
                    float votes[4] = {0};
                    int8_t pred = rf_predict(feats, votes);
                    float conf = votes[(int)pred];
                    uint8_t out_label = (conf >= CLASSIFIER_CONFIDENCE_THRESHOLD)
                                        ? (uint8_t)pred : CLASS_UNCERTAIN;
                    Serial.printf("[TEST] Prediction: %s (confidence=%.2f)\n",
                                  kClassLabels[out_label], conf);
                    Serial.printf("[TEST] Votes: N=%.2f S=%.2f D=%.2f R=%.2f\n",
                                  votes[0], votes[1], votes[2], votes[3]);
#else
                    Serial.println("[TEST] No model loaded.");
#endif
                    sample_idx = 0;
                    Serial.println("[TEST] Ready for next window.");
                }
            }
        } else {
            if (lpos < (int)sizeof(line) - 1) line[lpos++] = c;
        }
    }
}
